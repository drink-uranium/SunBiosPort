## configs/coreboot-qemu-i440fx.defconfig
```kconfig
CONFIG_VENDOR_EMULATION=y
CONFIG_BOARD_EMULATION_QEMU_X86_I440FX=y
CONFIG_ANY_TOOLCHAIN=y
CONFIG_PAYLOAD_ELF=y
CONFIG_PAYLOAD_FILE="/path/to/SunBiosPort/build/sunbios.elf"
CONFIG_GENERIC_LINEAR_FRAMEBUFFER=y
CONFIG_DRIVERS_EMULATION_QEMU_BOCHS=y
CONFIG_DRIVERS_EMULATION_QEMU_XRES=1024
CONFIG_DRIVERS_EMULATION_QEMU_YRES=768
```
